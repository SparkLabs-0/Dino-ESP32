// ============================================================
// Dino ESP - T-Rex style runner game for ESP32
// ============================================================
#include <Arduino.h>
#include <U8g2lib.h>
#include <Wire.h>

// ============================================================
// HARDWARE PINS
// ============================================================

#define BUTTON_PIN  5
#define BUZZER_PIN  10

// ============================================================
// DISPLAY
// ============================================================

U8G2_SSD1306_128X64_NONAME_F_HW_I2C display(U8G2_R0, U8X8_PIN_NONE);

// ============================================================
// GAME CONFIGURATION
// ============================================================

// Timing
#define DEBOUNCE_DELAY  180

// Layout
#define DINO_BASE_Y     38
#define GROUND_Y        60

// Jump physics
#define JUMP_HEIGHT     40
#define JUMP_SPEED      4

// Ground detail
#define NUM_TUFTS       6
#define NUM_PEBBLES     8

// Sound frequencies
#define FREQ_JUMP       900
#define FREQ_SCORE_LO   1200
#define FREQ_SCORE_HI   1500
#define FREQ_DEATH_HI   400
#define FREQ_DEATH_LO   200

// Game states
#define GAME_START      0
#define GAME_OVER       1
#define GAME_PLAYING    2

volatile int gameState = GAME_START;

// ============================================================
// BITMAPS
// ============================================================

// Dino sprites (20x21)
static unsigned char bmpDinoRun1[] = {
    0x00, 0xFC, 0x07, 0x00, 0xFE, 0x07, 0x00, 0xEE, 0x0F, 0x00, 0xFE, 0x0F,
    0x00, 0xFE, 0x0F, 0x00, 0x7E, 0x08, 0x00, 0x7E, 0x00, 0x06, 0xFF, 0x03,
    0x87, 0x3F, 0x00, 0xE7, 0xFF, 0x00, 0xFF, 0xFF, 0x00, 0xFF, 0xFF, 0x00,
    0xFF, 0x3F, 0x00, 0xFE, 0x3F, 0x00, 0xFC, 0x1F, 0x00, 0xF8, 0x1F, 0x00,
    0xF0, 0x1F, 0x00, 0xE0, 0x1E, 0x00, 0x60, 0x00, 0x00, 0xE0, 0x00, 0x00,
    0xE0, 0x00, 0x00,
};
static unsigned char bmpDinoRun2[] = {
    0x00, 0xFC, 0x07, 0x00, 0xEE, 0x07, 0x00, 0xE6, 0x0F, 0x00, 0xFE, 0x0F,
    0x00, 0xFE, 0x0F, 0x00, 0xFE, 0x0F, 0x00, 0x7C, 0x00, 0x06, 0xFF, 0x03,
    0xC3, 0xFF, 0x00, 0xE7, 0xFF, 0x00, 0xFF, 0xFF, 0x00, 0xFF, 0xFF, 0x00,
    0xFF, 0x3F, 0x00, 0xFE, 0x3F, 0x00, 0xFC, 0x1F, 0x00, 0xF8, 0x1F, 0x00,
    0xF0, 0x1F, 0x00, 0xF0, 0x0F, 0x00, 0xE0, 0x0E, 0x00, 0x00, 0x0E, 0x00,
    0x00, 0x1E, 0x00,
};
static unsigned char bmpDinoJump[] = {
    0x00, 0xFC, 0x07, 0x00, 0xFE, 0x07, 0x00, 0xEE, 0x0F, 0x00, 0xFE, 0x0F,
    0x00, 0xFE, 0x0F, 0x00, 0xFE, 0x0F, 0x00, 0xFE, 0x07, 0x06, 0xFF, 0x03,
    0xC3, 0xFF, 0x00, 0xE7, 0xFF, 0x00, 0xFF, 0xFF, 0x00, 0xFF, 0xFF, 0x00,
    0xFF, 0x3F, 0x00, 0xFE, 0x3F, 0x00, 0xFC, 0x1F, 0x00, 0xF8, 0x1F, 0x00,
    0xF0, 0x1F, 0x00, 0xF0, 0x0E, 0x00, 0x60, 0x0E, 0x00, 0xE0, 0x0E, 0x00,
    0xE0, 0x1E, 0x00,
};
static unsigned char bmpDinoDead[] = {
    0x00, 0xFC, 0x07, 0x00, 0xFE, 0x07, 0x00, 0xC6, 0x0F, 0x00, 0xC6, 0x0F,
    0x00, 0xCE, 0x0F, 0x00, 0xFE, 0x0F, 0x00, 0xFE, 0x0F, 0x06, 0xFF, 0x03,
    0x87, 0x7F, 0x00, 0xE7, 0xFF, 0x00, 0xFF, 0xFF, 0x00, 0xFF, 0xFF, 0x00,
    0xFF, 0x3F, 0x00, 0xFE, 0x3F, 0x00, 0xFC, 0x1F, 0x00, 0xF8, 0x1F, 0x00,
    0xF0, 0x1F, 0x00, 0xF0, 0x0E, 0x00, 0x60, 0x0E, 0x00, 0x60, 0x0E, 0x00,
    0xE0, 0x1E, 0x00,
};

// Cacti — large (10-20 x 20), small (6-17 x 12)
static unsigned char bmpCactus1[]      = { 0x30, 0x00, 0x78, 0x00, 0x78, 0x00, 0x78, 0x00, 0x78, 0x01, 0xFB, 0x03, 0xFF,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 0x00, 0x00 };
static unsigned char bmpCactus2[]      = { 0x30, 0xC0, 0x00, 0x38, 0xE0, 0x00, 0x38, 0xE8, 0x00, 0x38, 0xEC, 0x00, 0x38,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 0x00, 0x00 };
static unsigned char bmpCactus3[]      = { 0x00, 0xC0, 0x00, 0x18, 0xC0, 0x01, 0x18, 0xC0, 0x01, 0x58, 0xD8, 0x01, 0x58,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 0x00, 0x00 };
static unsigned char bmpCactusSmall1[] = { 0x0C, 0x0C, 0x3C, 0x3D, 0x2D, 0x3D, 0x1D, 0x0E, 0x0C, 0x0C, 0x0C, 0x0C };
static unsigned char bmpCactusSmall2[] = { 0x0C, 0x03, 0x0C, 0x03, 0x6C, 0x0B, 0x6D, 0x0B, 0x6D, 0x0B, 0xBD, 0x0B, 0x1F, 0x0F, 0x0E, 0x03, 0x0C, 0x03, 0x0C, 0x03, 0x0C, 0x03, 0x0C, 0x03 };
static unsigned char bmpCactusSmall3[] = { 0x04, 0x41, 0x00, 0x0C, 0x61, 0x00, 0xFC, 0x79, 0x01, 0xFD, 0x7D, 0x01, 0x7D,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 0x61, 0x00 };

// Cloud (39x12)
static unsigned char bmpCloud[] = {
    0x00, 0x00, 0xC0, 0x00, 0x00, 0x00, 0x00, 0xBE, 0x03, 0x00, 0x00, 0x00,
    0x03, 0x06, 0x00, 0x00, 0x80, 0x01, 0x04, 0x00, 0x00, 0x40, 0x00, 0x1C,
    0x00, 0x00, 0x40, 0x00, 0xE4, 0x03, 0x00, 0x18, 0x00, 0x00, 0x02, 0xE0,
    0x0F, 0x00, 0x00, 0x0E, 0x30, 0x00, 0x00, 0x00, 0x10, 0x10, 0x00, 0x00,
    0x00, 0x20, 0x12, 0x00, 0x00, 0x00, 0x40, 0x03, 0xFF, 0xFF, 0xFF, 0x7F,
};

// Game Over banner (100x15)
static unsigned char bmpGameOver[] = {
    0x00, 0x00, 0x00, 0x00, 0x00, 0x00, 0x00, 0x00, 0x00, 0x00, 0x00, 0x00,
    0x00, 0x00, 0x00, 0x00, 0x00, 0x00, 0x00, 0x00, 0x00, 0x00, 0x00, 0x00,
    0x00, 0x00, 0x00, 0x00, 0x00, 0x00, 0x00, 0x00, 0x00, 0x00, 0x00, 0x00,
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    0x00, 0x00, 0x00,
};

// Start screen logos (32x32)
static unsigned char bmpChromeLogo[] = {
    0x00, 0xf0, 0x0f, 0x00, 0x00, 0xfe, 0x7f, 0x00, 0x80, 0xff, 0xff, 0x01,
    0xc0, 0xff, 0xff, 0x03, 0xe0, 0xff, 0xff, 0x07, 0xf0, 0xff, 0xff, 0x0f,
    0xf0, 0xff, 0xff, 0x1f, 0xe0, 0xff, 0xff, 0x3f, 0xc4, 0xff, 0xff, 0x3f,
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    0x00, 0x3e, 0x7f, 0x00, 0x00, 0x90, 0x0f, 0x00,
};
static unsigned char bmpDinoLogo[] = {
    0x00, 0x00, 0x00, 0x00, 0x00, 0x00, 0x00, 0x00, 0x00, 0x00, 0x00, 0x00,
    0x00, 0x00, 0x00, 0x00, 0x00, 0x00, 0x00, 0x00, 0x00, 0x00, 0x00, 0x00,
    0x00, 0xf0, 0x07, 0x00, 0x00, 0x28, 0x08, 0x00, 0x00, 0x68, 0x10, 0x00,
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    0x00, 0x00, 0x00, 0x00, 0x00, 0x00, 0x00, 0x00,
};

// ============================================================
// SOUND
// ============================================================

bool          soundActive   = false;
int           soundFreq     = 0;
unsigned long soundStart    = 0;
unsigned long soundDuration = 0;

void playTone(int freq, int duration) {
    soundFreq     = freq;
    soundDuration = duration;
    soundStart    = millis();
    soundActive   = true;
    ledcWriteTone(0, freq);
}

void updateSound() {
    if (soundActive && millis() - soundStart >= soundDuration) {
        ledcWrite(0, 0);
        soundActive = false;
    }
}

// ============================================================
// GROUND
// ============================================================

int tuftX[NUM_TUFTS];
int pebbleX[NUM_PEBBLES];
int pebbleY[NUM_PEBBLES];

void initGround() {
    for (int i = 0; i < NUM_TUFTS; i++)
        tuftX[i] = i * 22 + random(0, 8);

    for (int i = 0; i < NUM_PEBBLES; i++) {
        pebbleX[i] = random(0, 128);
        pebbleY[i] = random(0, 2);
    }
}

int speed = 4;
void scrollGround() {
    for (int i = 0; i < NUM_TUFTS; i++) {
        tuftX[i] -= speed;
        if (tuftX[i] < -4) tuftX[i] += 132;
    }
    for (int i = 0; i < NUM_PEBBLES; i++) {
        pebbleX[i] -= speed;
        if (pebbleX[i] < -2) pebbleX[i] += 130;
    }
}

void drawGround() {
    display.drawHLine(0, GROUND_Y,     128);
    display.drawHLine(0, GROUND_Y + 1, 128);

    for (int i = 0; i < NUM_TUFTS; i++) {
        int x = tuftX[i];
        display.drawLine(x,     GROUND_Y,     x - 1, GROUND_Y - 3);
        display.drawLine(x + 1, GROUND_Y,     x + 2, GROUND_Y - 3);
        display.drawLine(x,     GROUND_Y - 1, x,     GROUND_Y - 4);
    }

    for (int i = 0; i < NUM_PEBBLES; i++) {
        display.drawPixel(pebbleX[i],     GROUND_Y + 2 + pebbleY[i]);
        display.drawPixel(pebbleX[i] + 1, GROUND_Y + 2 + pebbleY[i]);
    }
}

// ============================================================
// SCORE
// ============================================================

int           score     = 0;
int           lastBeep  = 0;
unsigned long startTime = millis();

void updateScore() {
    if (gameState != GAME_PLAYING) return;

    unsigned long curTime = millis();
    score = (curTime - startTime) * speed / 1000;

    if (score / 100 > lastBeep) {
        playTone(FREQ_SCORE_LO, 40);
        delay(50);
        playTone(FREQ_SCORE_HI, 40);
        lastBeep = score / 100;
    }
}

void drawScore() {
    String scoreStr = "Score: " + String(score);
    display.drawStr(5, 2, scoreStr.c_str());
}

// ============================================================
// DINO
// ============================================================

int          dinoY       = 0;
volatile int jumpingState = 0;

void drawDino() {
    if (gameState == GAME_OVER) {
        display.drawXBMP(0, DINO_BASE_Y - dinoY, 20, 21, bmpDinoDead);
        return;
    }

    switch (dinoY) {
        case -1: display.drawXBMP(0, DINO_BASE_Y,          20, 21, bmpDinoDead); break;
        case  0: display.drawXBMP(0, DINO_BASE_Y,          20, 21, bmpDinoJump); break;
        case  1: display.drawXBMP(0, DINO_BASE_Y,          20, 21, bmpDinoRun1); break;
        case  2: display.drawXBMP(0, DINO_BASE_Y,          20, 21, bmpDinoRun2); break;
        default: display.drawXBMP(0, DINO_BASE_Y - dinoY,  20, 21, bmpDinoJump); break;
    }
}

void moveDino() {
    if (jumpingState == 0) {
        dinoY = (dinoY + 1) % 3;
    } else if (jumpingState == 1) {
        dinoY += JUMP_SPEED;
        if (dinoY > JUMP_HEIGHT) jumpingState = 2;
    } else {
        dinoY -= JUMP_SPEED;
        if (dinoY < JUMP_SPEED) {
            jumpingState = 0;
            dinoY        = 0;
        }
    }
}

// ============================================================
// OBSTACLES
// ============================================================

int obstacles[2] = {1, 2};
int obstacleX[2] = {128, 200};

void moveObstacles() {
    int obX = obstacleX[0] - speed;

    if (obX < -20) {
        obstacleX[0] = obstacleX[1];
        obstacleX[1] = obstacleX[0] + random(80, 125);
        obstacles[0] = obstacles[1];
        obstacles[1] = random(1, 3);
    } else {
        obstacleX[0] = obX;
        obstacleX[1] -= speed;
    }
}

void drawObstacle(int shape, int x) {
    switch (shape) {
        case 1: display.drawXBMP(x, GROUND_Y - 20, 10, 20, bmpCactus1);      break;
        case 2: display.drawXBMP(x, GROUND_Y - 20, 20, 20, bmpCactus2);      break;
        case 3: display.drawXBMP(x, GROUND_Y - 20, 20, 20, bmpCactus3);      break;
        case 4: display.drawXBMP(x, GROUND_Y - 12,  6, 12, bmpCactusSmall1); break;
        case 5: display.drawXBMP(x, GROUND_Y - 12, 12, 12, bmpCactusSmall2); break;
        case 6: display.drawXBMP(x, GROUND_Y - 12, 17, 12, bmpCactusSmall3); break;
    }
}

void drawObstacles() {
    drawObstacle(obstacles[0], obstacleX[0]);
    drawObstacle(obstacles[1], obstacleX[1]);
}

// ============================================================
// COLLISION
// ============================================================

void checkCollision() {
    int obX = obstacleX[0];
    int obW, obH;

    switch (obstacles[0]) {
        case 1: obW = 10; obH = 20; break;
        case 2: obW = 17; obH = 20; break;
        case 3: obW = 17; obH = 20; break;
        case 4: obW =  6; obH = 12; break;
        case 5: obW = 12; obH = 12; break;
        case 6: obW = 17; obH = 12; break;
        default: return;
    }

    if (!(obX > 15 || obX + obW < 5 || dinoY > obH - 3)) {
        gameState = GAME_OVER;
        playTone(FREQ_DEATH_HI, 80);
        delay(80);
        playTone(FREQ_DEATH_LO, 120);
    }
}

// ============================================================
// CLOUD
// ============================================================

int cloudX = 128;

void moveCloud() {
    cloudX--;
    if (cloudX < -38) cloudX = 128;
}

void drawCloud() {
    display.drawXBMP(cloudX, 4, 39, 12, bmpCloud);
}

// ============================================================
// BUTTON / INPUT
// ============================================================

bool interruptFlag = false;

void ARDUINO_ISR_ATTR buttonISR() {
    interruptFlag = true;
}

void handleButton() {
    static unsigned long lastInterrupt = 0;
    unsigned long        now           = millis();

    if (now - lastInterrupt <= DEBOUNCE_DELAY) return;
    lastInterrupt = now;

    if (gameState == GAME_PLAYING) {
        if (jumpingState == 0) {
            jumpingState = 1;
            playTone(FREQ_JUMP, 60);
        }
        return;
    }

    if (gameState == GAME_START) { gameState = GAME_PLAYING; return; }
    if (gameState == GAME_OVER)  { gameState = GAME_START;   return; }
}

// ============================================================
// GAME LIFECYCLE
// ============================================================

void resetGame() {
    score        = 0;
    startTime    = millis();
    obstacleX[0] = 128;
    obstacleX[1] = 200;
    dinoY        = 0;
    jumpingState = 0;
    lastBeep     = 0;
    initGround();
}

// ============================================================
// RENDERING
// ============================================================

void prepareDisplay() {
    display.setFont(u8g_font_6x10);
    display.setFontRefHeightExtendedText();
    display.setDrawColor(1);
    display.setFontPosTop();
}

void drawGame() {
    prepareDisplay();

    if (gameState == GAME_PLAYING) {
        updateScore();
        drawDino();
        drawCloud();
        drawObstacles();
        drawGround();
    } else if (gameState == GAME_START) {
        display.drawStr(2, 2, "Welcome to Dino ESP!!");
        display.drawXBMP(6,  17, 32, 32, bmpChromeLogo);
        display.drawXBMP(45, 17, 32, 32, bmpDinoLogo);
        if (millis() / 500 % 2 == 0)
            display.drawStr(2, 54, "Push to begin");
        resetGame();
    } else {
        drawDino();
        drawCloud();
        drawObstacles();
        drawGround();
        display.drawXBMP(14, 12, 100, 15, bmpGameOver);
        String scoreStr = "Score: " + String(score);
        display.drawStr(35, 30, scoreStr.c_str());
    }
}

// ============================================================
// SETUP & LOOP
// ============================================================

void setup() {
    Serial.begin(115200);
    Wire.begin();
    Serial.println("Dino ESP starting...");

    display.begin();
    resetGame();

    pinMode(BUTTON_PIN, INPUT_PULLUP);
    pinMode(7, OUTPUT); digitalWrite(7, LOW);
    pinMode(BUZZER_PIN, OUTPUT);

    ledcSetup(0, 1000, 8);
    ledcAttachPin(BUZZER_PIN, 0);

    attachInterrupt(digitalPinToInterrupt(BUTTON_PIN), buttonISR, FALLING);
}

void loop() {
    if (interruptFlag) {
        handleButton();
        interruptFlag = false;
    }

    display.firstPage();
    do { drawGame(); } while (display.nextPage());

    if (gameState == GAME_PLAYING) {
        moveDino();
        moveCloud();
        moveObstacles();
        scrollGround();
        checkCollision();
    }

    updateScore();
    updateSound();
}
